## br2-external/Config.in
```kconfig
menu "SK-18 packages"
source "$BR2_EXTERNAL_SK18_PATH/package/sk18-keys/Config.in"
source "$BR2_EXTERNAL_SK18_PATH/package/sk18-wifi-firmware/Config.in"
endmenu
```

## br2-external/package/sk18-keys/Config.in
```kconfig
config BR2_PACKAGE_SK18_KEYS
	bool "sk18-keys"
	depends on BR2_PACKAGE_HOST_RUSTC_TARGET_ARCH_SUPPORTS
	select BR2_PACKAGE_HOST_RUSTC
	help
	  Reads the key events of the Waveshare SK-18. The 18 on-screen
	  keys are reported by a separate controller over UART1 (115200
	  baud); this decodes the frames and prints the events, with the
	  key numbering mapped for the way the device is held.

	  Source: client/sk18-keys in this repository.
```

## br2-external/package/sk18-link/Config.in
```kconfig
config BR2_PACKAGE_SK18_LINK
	bool "sk18-link"
	depends on BR2_PACKAGE_HOST_RUSTC_TARGET_ARCH_SUPPORTS
	select BR2_PACKAGE_HOST_RUSTC
	help
	  The SK-18 as a deck for controldeck: the device side of the deck
	  protocol on the USB gadget's serial port. Shows the pictures the
	  host sends on the panel and reports key presses from the UART1
	  controller.

	  Source: client/sk18-link in this repository.
```

## br2-external/package/sk18-splash/Config.in
```kconfig
config BR2_PACKAGE_SK18_SPLASH
	bool "sk18-splash"
	depends on BR2_PACKAGE_HOST_RUSTC_TARGET_ARCH_SUPPORTS
	select BR2_PACKAGE_HOST_RUSTC
	help
	  Boot animation of the Waveshare SK-18: every key in its own
	  colour, then SK18 on the four middle keys, then black. Drawn
	  straight to the framebuffer; the backlight is switched on after
	  the first frame.

	  Source: client/sk18-splash in this repository.
```

## br2-external/package/sk18-wifi-firmware/Config.in
```kconfig
config BR2_PACKAGE_SK18_WIFI_FIRMWARE
	bool "sk18-wifi-firmware"
	help
	  Firmware of the RTL8188GU (RTL8710BU) USB Wi-Fi adapter used with
	  the Waveshare SK-18: rtlwifi/rtl8710bufw_SMIC.bin and
	  rtl8710bufw_UMC.bin, which the rtl8xxxu driver loads.

	  Only these two files and their licence are downloaded, from the
	  same linux-firmware release as Buildroot's own linux-firmware
	  package, not the whole firmware tree. The firmware is Realtek's
	  and is redistributable in binary form under the licence installed
	  with it (/usr/share/doc/sk18-wifi-firmware).
```
